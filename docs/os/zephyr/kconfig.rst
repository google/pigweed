## pw_log_zephyr/Kconfig
```kconfig
# Copyright 2021 The Pigweed Authors
#
# Licensed under the Apache License, Version 2.0 (the "License"); you may not
# use this file except in compliance with the License. You may obtain a copy of
# the License at
#
#     https://www.apache.org/licenses/LICENSE-2.0
#
# Unless required by applicable law or agreed to in writing, software
# distributed under the License is distributed on an "AS IS" BASIS, WITHOUT
# WARRANTIES OR CONDITIONS OF ANY KIND, either express or implied. See the
# License for the specific language governing permissions and limitations under
# the License.

menu "pw_log"

choice PIGWEED_LOG
    prompt "Logging backend used"
    default PIGWEED_LOG_ZEPHYR if CPP
    default PIGWEED_LOG_NONE
    help
      The type of Zephyr pw_log backend to use. See :ref:`module-pw_log` for
      module details

config PIGWEED_LOG_NONE
    bool "Do not use Pigweed logging"
    help
      PW_LOG_ statements will not work.

config PIGWEED_LOG_ZEPHYR
    bool "Zephyr logging for PW_LOG_* statements"
    select PIGWEED_PREPROCESSOR
    help
      Once the Pigweed logging is enabled, all Pigweed logs via PW_LOG_*() will
      be routed to the Zephyr logging system. This means that:
      - :c:macro:`PW_LOG_LEVEL_DEBUG` maps to Zephyr's LOG_LEVEL_DBG
      - :c:macro:`PW_LOG_LEVEL_INFO` maps to Zephyr's LOG_LEVEL_INF
      - :c:macro:`PW_LOG_LEVEL_WARN` maps to Zephyr's LOG_LEVEL_WRN
      - :c:macro:`PW_LOG_LEVEL_ERROR` maps to Zephyr's LOG_LEVEL_ERR
      - :c:macro:`PW_LOG_LEVEL_CRITICAL` maps to Zephyr's LOG_LEVEL_ERR
      - :c:macro:`PW_LOG_LEVEL_FATAL` maps to Zephyr's LOG_LEVEL_ERR

menuconfig PIGWEED_LOG_TOKENIZED
    bool "Maps all Zephyr log macros to tokenized PW_LOG_* macros"
    select PIGWEED_PREPROCESSOR
    select PIGWEED_SYNC_INTERRUPT_SPIN_LOCK
    select PIGWEED_SYS_IO
    select PIGWEED_TOKENIZER
    select LOG_CUSTOM_HEADER
    select SHELL_CUSTOM_HEADER
    help
      Map all the Zephyr log macros to use Pigweed's then use the
      :ref:`module-pw_log_tokenized` target as the logging backend in order to
      automatically tokenize all the logging strings. This means that Pigweed
      will also tokenize all of Zephyr's logging statements.

config PIGWEED_LOG_TOKENIZED_LIB
    bool "Tokenize logging and implement your own pw_log_tokenized_HandleLog"
    select PIGWEED_TOKENIZER
    select LOG_CUSTOM_HEADER
    select SHELL_CUSTOM_HEADER
    help
      Same as PIGWEED_LOG_TOKENIZED but you'll need to implement
      pw_log_tokenized_HandleLog. This gives you flexiblity to access handlers
      outside of pigweed.

config PIGWEED_LOG_NONE
    bool "Do not use pigweed logging"
    help
      Pigweed log macros will not work unless the application manually
      configures the logging backend.

menuconfig PIGWEED_LOG_TOKENIZED_RPC
    bool "Enables RPC tokenized logging"
    select PIGWEED_SYNC_INTERRUPT_SPIN_LOCK
    select PIGWEED_SYNC_THREAD_NOTIFICATION
    select PIGWEED_SYNC_TIMED_THREAD_NOTIFICATION
    select PIGWEED_SYSTEM_HDLC_RPC_SERVER
    select PIGWEED_SYSTEM_LOG_BACKEND
    select PIGWEED_SYSTEM_TARGET_HOOKS
    select PIGWEED_THREAD
    select PIGWEED_THREAD_ITERATION
    select PIGWEED_TOKENIZER
    select LOG_CUSTOM_HEADER
    select SHELL_CUSTOM_HEADER
    depends on CONSOLE_GETCHAR
    help
      Enable tokenized logging over RPC by using the system log backend.

endchoice

if PIGWEED_LOG_ZEPHYR || PIGWEED_LOG_TOKENIZED || PIGWEED_LOG_TOKENIZED_RPC

choice "PIGWEED_LOG_LEVEL_CHOICE"
	prompt "Max compiled-in log level for pigweed"
	default PIGWEED_LOG_LEVEL_DEFAULT
	depends on LOG

config PIGWEED_LOG_LEVEL_OFF
	bool "Off"
	help
	  Turn off all Pigweed logging.

config PIGWEED_LOG_LEVEL_ERR
	bool "Error"
	help
	  Only print error level log statements.

config PIGWEED_LOG_LEVEL_WRN
	bool "Warning"
	help
	  Only print warning level log statements and above.

config PIGWEED_LOG_LEVEL_INF
	bool "Info"
	help
	  Only print info level log statements and above.

config PIGWEED_LOG_LEVEL_DBG
	bool "Debug"
	help
	  Print all log statements.

config PIGWEED_LOG_LEVEL_DEFAULT
	bool "Default"
	help
	  Use Zephyr's ``LOG_DEFAULT_LEVEL`` as the log level.

endchoice

config PIGWEED_LOG_LEVEL
	int
	depends on LOG
	default 0 if PIGWEED_LOG_LEVEL_OFF
	default 1 if PIGWEED_LOG_LEVEL_ERR
	default 2 if PIGWEED_LOG_LEVEL_WRN
	default 3 if PIGWEED_LOG_LEVEL_INF
	default 4 if PIGWEED_LOG_LEVEL_DBG
	default LOG_DEFAULT_LEVEL if PIGWEED_LOG_LEVEL_DEFAULT

endif # PIGWEED_LOG_ZEPHYR || PIGWEED_LOG_TOKENIZED || PIGWEED_LOG_TOKENIZED_RPC

if PIGWEED_LOG_TOKENIZED
rsource "Kconfig.tokenized"
endif # PIGWEED_LOG_TOKENIZED

endmenu
```

## pw_log_zephyr/Kconfig.tokenized
```kconfig
# Copyright 2023 The Pigweed Authors
#
# Licensed under the Apache License, Version 2.0 (the "License"); you may not
# use this file except in compliance with the License. You may obtain a copy of
# the License at
#
#     https://www.apache.org/licenses/LICENSE-2.0
#
# Unless required by applicable law or agreed to in writing, software
# distributed under the License is distributed on an "AS IS" BASIS, WITHOUT
# WARRANTIES OR CONDITIONS OF ANY KIND, either express or implied. See the
# License for the specific language governing permissions and limitations under
# the License.

config PIGWEED_LOG_TOKENIZED_LEVEL_BITS
    int "Number of bits required to present the log level"
    default 3
    help
      The total representation size of the metadata is the sum of
      - ``CONFIG_PIGWEED_LOG_TOKENIZED_LEVEL_BITS``
      - ``CONFIG_PIGWEED_LOG_TOKENIZED_LINE_BITS``
      - ``CONFIG_PIGWEED_LOG_TOKENIZED_FLAG_BITS``
      - ``CONFIG_PIGWEED_LOG_TOKENIZED_MODULE_BITS``

config PIGWEED_LOG_TOKENIZED_LINE_BITS
    int "Number of bits required to present the log line number"
    default 11
    help
      The total representation size of the metadata is the sum of
      - ``CONFIG_PIGWEED_LOG_TOKENIZED_LEVEL_BITS``
      - ``CONFIG_PIGWEED_LOG_TOKENIZED_LINE_BITS``
      - ``CONFIG_PIGWEED_LOG_TOKENIZED_FLAG_BITS``
      - ``CONFIG_PIGWEED_LOG_TOKENIZED_MODULE_BITS``

config PIGWEED_LOG_TOKENIZED_FLAG_BITS
    int "Number of bits required for implementation-defined flags"
    default 2
    help
      The total representation size of the metadata is the sum of
      - ``CONFIG_PIGWEED_LOG_TOKENIZED_LEVEL_BITS``
      - ``CONFIG_PIGWEED_LOG_TOKENIZED_LINE_BITS``
      - ``CONFIG_PIGWEED_LOG_TOKENIZED_FLAG_BITS``
      - ``CONFIG_PIGWEED_LOG_TOKENIZED_MODULE_BITS``

config PIGWEED_LOG_TOKENIZED_MODULE_BITS
    int "Number of bits required for logging the PW_LOG_MODULE_NAME"
    default 16
    help
      The total representation size of the metadata is the sum of
      - ``CONFIG_PIGWEED_LOG_TOKENIZED_LEVEL_BITS``
      - ``CONFIG_PIGWEED_LOG_TOKENIZED_LINE_BITS``
      - ``CONFIG_PIGWEED_LOG_TOKENIZED_FLAG_BITS``
      - ``CONFIG_PIGWEED_LOG_TOKENIZED_MODULE_BITS``
```

## pw_minimal_cpp_stdlib/Kconfig
```kconfig
# Copyright 2023 The Pigweed Authors
#
# Licensed under the Apache License, Version 2.0 (the "License"); you may not
# use this file except in compliance with the License. You may obtain a copy of
# the License at
#
#     https://www.apache.org/licenses/LICENSE-2.0
#
# Unless required by applicable law or agreed to in writing, software
# distributed under the License is distributed on an "AS IS" BASIS, WITHOUT
# WARRANTIES OR CONDITIONS OF ANY KIND, either express or implied. See the
# License for the specific language governing permissions and limitations under
# the License.

config PIGWEED_MINIMAL_CPP_STDLIB
    bool "Link pw_minimal_cpp_stdlib"
    depends on STD_CPP17 || STD_CPP2A || STD_CPP20 || STD_CPP2B
    help
      Uses the pw_minimal_cpp_stdlib C++ standard library implementation.
      The build must set `-nostdinc++` to exclude the toolchain's standard
      library. This is NOT a full standard library implementation and may
      only be used to build pw_tokenizer.
      see :ref:'module-pw_minimal_cpp_stdlib' for module details.
```

## pw_multisink/Kconfig
```kconfig
# Copyright 2023 The Pigweed Authors
#
# Licensed under the Apache License, Version 2.0 (the "License"); you may not
# use this file except in compliance with the License. You may obtain a copy of
# the License at
#
#     https://www.apache.org/licenses/LICENSE-2.0
#
# Unless required by applicable law or agreed to in writing, software
# distributed under the License is distributed on an "AS IS" BASIS, WITHOUT
# WARRANTIES OR CONDITIONS OF ANY KIND, either express or implied. See the
# License for the specific language governing permissions and limitations under
# the License.

menu "pw_multisink"

config PIGWEED_MULTISINK
    bool "Multisink module used for forwarding multiple attached sinks"

if PIGWEED_MULTISINK

config PIGWEED_MULTISINK_LOCK_INTERRUPT_SAFE
    bool "Use an interrupt safe lock"
    default y
    help
      When reading and writing from the underlying ring-buffer. The multisink
      module will use an interrupt safe lock instead of a mutex.

config PIGWEED_MULTISINK_UTIL
    bool "Utility library for the multisink module"

endif # PIGWEED_MULTISINK

endmenu
```

## pw_rpc/nanopb/Kconfig
```kconfig
# Copyright 2021 The Pigweed Authors
#
# Licensed under the Apache License, Version 2.0 (the "License"); you may not
# use this file except in compliance with the License. You may obtain a copy of
# the License at
#
#     https://www.apache.org/licenses/LICENSE-2.0
#
# Unless required by applicable law or agreed to in writing, software
# distributed under the License is distributed on an "AS IS" BASIS, WITHOUT
# WARRANTIES OR CONDITIONS OF ANY KIND, either express or implied. See the
# License for the specific language governing permissions and limitations under
# the License.

menu "nanopb"

config PIGWEED_RPC_NANOPB_METHOD
    bool "Link pw_rpc.nanopb.method library"
    select PIGWEED_RPC_NANOPB_COMMON
    select PIGWEED_RPC_SERVER
    select PIGWEED_LOG
    help
      See :ref:`module-pw_rpc_nanopb` for module details.

config PIGWEED_RPC_NANOPB_METHOD_UNION
    bool "Link pw_rpc.nanopb.method_union library"
    select PIGWEED_RPC_NANOPB_METHOD
    select PIGWEED_RPC_RAW
    select PIGWEED_RPC_SERVER
    select PIGWEED_LOG
    help
      See :ref:`module-pw_rpc_nanopb` for module details.

config PIGWEED_RPC_NANOPB_CLIENT
    bool "Link pw_rpc.nanopb.client library"
    select PIGWEED_FUNCTION
    select PIGWEED_RPC_NANOPB_COMMON
    select PIGWEED_RPC_COMMON
    help
      See :ref:`module-pw_rpc_nanopb` for module details.

config PIGWEED_RPC_NANOPB_COMMON
    bool "Link pw_rpc.nanopb.common library"
    select PIGWEED_BYTES
    select PIGWEED_LOG
    select PIGWEED_RPC_COMMON
    help
      See :ref:`module-pw_rpc_nanopb` for module details.

config PIGWEED_RPC_NANOPB_ECHO_SERVICE
    bool "Link pw_rpc.nanopb.echo_service library"
    help
      See :ref:`module-pw_rpc_nanopb` for module details.

endmenu
```

## pw_sync_zephyr/Kconfig
```kconfig
# Copyright 2021 The Pigweed Authors
#
# Licensed under the Apache License, Version 2.0 (the "License"); you may not
# use this file except in compliance with the License. You may obtain a copy of
# the License at
#
#     https://www.apache.org/licenses/LICENSE-2.0
#
# Unless required by applicable law or agreed to in writing, software
# distributed under the License is distributed on an "AS IS" BASIS, WITHOUT
# WARRANTIES OR CONDITIONS OF ANY KIND, either express or implied. See the
# License for the specific language governing permissions and limitations under
# the License.

menu "pw_sync"

config PIGWEED_SYNC
    bool
    select PIGWEED_CHRONO_SYSTEM_CLOCK
    select PIGWEED_PREPROCESSOR
    select PIGWEED_INTERRUPT_CONTEXT

config PIGWEED_SYNC_MUTEX
    bool "Link pw_sync.mutex library"
    select PIGWEED_SYNC
    select PIGWEED_POLYFILL
    help
      See :ref:`module-pw_sync` for module details.

config PIGWEED_SYNC_BINARY_SEMAPHORE
    bool "Link pw_sync.binary_semaphore library"
    select PIGWEED_SYNC
    help
      See :ref:`module-pw_sync` for module details.

config PIGWEED_SYNC_INTERRUPT_SPIN_LOCK
    bool "Link pw_sync.interrupt_spin_lock library"
    help
      See :ref:`module-pw_sync` for module details.

config PIGWEED_SYNC_THREAD_NOTIFICATION
    bool "Link pw_sync.thread_notification library"
    select PIGWEED_SYNC_BINARY_SEMAPHORE
    help
      See :ref:`module-pw_sync` for module details.

config PIGWEED_SYNC_TIMED_THREAD_NOTIFICATION
    bool "Link pw_sync.timed_thread_notification library"
    select PIGWEED_SYNC_BINARY_SEMAPHORE
    help
      See :ref:`module-pw_sync` for module details.

endmenu
```

## pw_system/Kconfig
```kconfig
# Copyright 2023 The Pigweed Authors
#
# Licensed under the Apache License, Version 2.0 (the "License"); you may not
# use this file except in compliance with the License. You may obtain a copy of
# the License at
#
#     https://www.apache.org/licenses/LICENSE-2.0
#
# Unless required by applicable law or agreed to in writing, software
# distributed under the License is distributed on an "AS IS" BASIS, WITHOUT
# WARRANTIES OR CONDITIONS OF ANY KIND, either express or implied. See the
# License for the specific language governing permissions and limitations under
# the License.

menu "pw_system"

config PIGWEED_SYSTEM_LOG_BACKEND
    bool "Enables pw_system.log_backend backend"
config PIGWEED_SYSTEM_TARGET_HOOKS
    bool "Enables the Zephyr pw_system.target_hooks backend"
config PIGWEED_SYSTEM_HDLC_RPC_SERVER
    bool "Enables the Zephyr pw_system.hdlc_rpc_server backend"

if PIGWEED_SYSTEM_TARGET_HOOKS
config PIGWEED_SYSTEM_TARGET_HOOKS_LOG_STACK_SIZE
    int "Log thread stack size"
    default 4096
config PIGWEED_SYSTEM_TARGET_HOOKS_RPC_STACK_SIZE
    int "RPC thread stack size"
    default 4096
config PIGWEED_SYSTEM_TARGET_HOOKS_WORK_QUEUE_STACK_SIZE
    int "Work Queue thread stack size"
    default 4096
endif # PIGWEED_SYSTEM_TARGET_HOOKS

endmenu
```

## pw_thread_zephyr/Kconfig
```kconfig
# Copyright 2023 The Pigweed Authors
#
# Licensed under the Apache License, Version 2.0 (the "License"); you may not
# use this file except in compliance with the License. You may obtain a copy of
# the License at
#
#     https://www.apache.org/licenses/LICENSE-2.0
#
# Unless required by applicable law or agreed to in writing, software
# distributed under the License is distributed on an "AS IS" BASIS, WITHOUT
# WARRANTIES OR CONDITIONS OF ANY KIND, either express or implied. See the
# License for the specific language governing permissions and limitations under
# the License.

menu "pw_thread"

config PIGWEED_THREAD_SLEEP
    bool "Enabled the Zephyr pw_thread.sleep backend"
    select PIGWEED_CHRONO_SYSTEM_CLOCK
    select PIGWEED_ASSERT

config PIGWEED_THREAD
    bool "Enables the Zephyr pw_thread.thread and pw_thread.id backends"
    select PIGWEED_ASSERT

config PIGWEED_THREAD_ITERATION
    bool "Enables the Zephyr pw_thread.thread_iteration backend"
    select PIGWEED_ASSERT
    select PIGWEED_THREAD

if PIGWEED_THREAD

config PIGWEED_THREAD_DEFAULT_PRIORITY
  int "Default thread priority"
  default MAIN_THREAD_PRIORITY

config PIGWEED_THREAD_NUM_COOP_PRIORITIES
  int "Number of cooperative thread priorities"
  default NUM_COOP_PRIORITIES
  range 0 NUM_COOP_PRIORITIES

config PIGWEED_THREAD_NUM_PREEMPT_PRIORITIES
  int "Number of preemptible thread priorities"
  default NUM_PREEMPT_PRIORITIES
  range 0 NUM_PREEMPT_PRIORITIES

endif # PIGWEED_THREAD

endmenu
```
